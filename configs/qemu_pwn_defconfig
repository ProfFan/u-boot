## configs/qemu_pwn_defconfig
```kconfig
CONFIG_ARM=y
CONFIG_ARM_SMCCC=y
CONFIG_ARCH_QEMU=y
CONFIG_TARGET_QEMU_ARM_32BIT=y
CONFIG_AHCI=y
CONFIG_DISTRO_DEFAULTS=y
CONFIG_NR_DRAM_BANKS=1
CONFIG_FIT=y
CONFIG_BOOTDELAY=0
CONFIG_BOOTCOMMAND="setenv ipaddr 169.254.169.1; setenv serverip 169.254.169.254; setenv gatewayip 169.254.169.253; setenv netmask 255.255.0.0; demo net; wget 0x40000000 test; md 40000000 4; wget 0x40000000 test; md 40000000 4; sleep 1; reset"
CONFIG_SYS_CONSOLE_INFO_QUIET=y
CONFIG_LOG_DEFAULT_LEVEL=0
# CONFIG_DISPLAY_CPUINFO is not set
# CONFIG_DISPLAY_BOARDINFO is not set
CONFIG_CMD_BOOTEFI_SELFTEST=y
CONFIG_CMD_DEMO=y
CONFIG_CMD_PCI=y
CONFIG_CMD_USB=y
CONFIG_CMD_PWN=y
CONFIG_CMD_WGET=y
CONFIG_CMD_TIMER=y
CONFIG_OF_BOARD=y
CONFIG_ENV_IS_IN_FLASH=y
CONFIG_DM_DEBUG=y
CONFIG_SCSI_AHCI=y
CONFIG_AHCI_PCI=y
CONFIG_BLK=y
CONFIG_DM_DEMO=y
CONFIG_DM_DEMO_SIMPLE=y
# CONFIG_MMC is not set
CONFIG_MTD=y
CONFIG_MTD_NOR_FLASH=y
CONFIG_FLASH_CFI_DRIVER=y
CONFIG_CFI_FLASH=y
CONFIG_SYS_FLASH_USE_BUFFER_WRITE=y
CONFIG_SYS_FLASH_CFI=y
CONFIG_DM_ETH=y
CONFIG_NVME=y
CONFIG_PCI=y
CONFIG_DM_PCI=y
CONFIG_PCIE_ECAM_GENERIC=y
CONFIG_SCSI=y
CONFIG_DM_SCSI=y
CONFIG_SYSRESET=y
CONFIG_SYSRESET_PSCI=y
CONFIG_USB=y
CONFIG_DM_USB=y
CONFIG_USB_EHCI_HCD=y
CONFIG_USB_EHCI_PCI=y
# CONFIG_VIRTIO_MMIO is not set
CONFIG_EFI_LOADER_HII=y
```

## net/Kconfig
```kconfig
#
# Network configuration
#

menuconfig NET
	bool "Networking support"
	default y

if NET

config NET_RANDOM_ETHADDR
	bool "Random ethaddr if unset"
	help
	  Selecting this will allow the Ethernet interface to function
	  even when the ethaddr variable for that interface is unset.
	  A new MAC address will be generated on every boot and it will
	  not be added to the environment.

config TCP
	bool "Include Subset TCP stack for wget"
	help
	  Selecting TCP protocol support adds TCP for receiving
	  streams of data. The TCP packets are presented
	  as received (possibly out of order). The application
	  receiving the TCP stream places the date by sequence number
	  as an offset from the kernel address. TCP transmission is
	  not supported.

config NETCONSOLE
	bool "NetConsole support"
	help
	  Support the 'nc' input/output device for networked console.
	  See README.NetConsole for details.

endif   # if NET
```
